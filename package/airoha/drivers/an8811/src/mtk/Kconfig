## package/mtk/drivers/warp/config.in
```kconfig
if PACKAGE_kmod-warp

config WARP_CONFIG_MODE
	int "WARP Configuration Mode"
	help
		For project Jaguar and before (<= WARP_V3), please use mode = 0
		For project Griffin and later (>= WARP_V3_1), please use mode = 1
	default 0
	default 1 if TARGET_mediatek_mt7987

config WARP_CHIPSET
	string "WARP Driver HW Chipset"
	default mt7622 if TARGET_mediatek_mt7622
	default mt7986 if TARGET_mediatek_mt7986
	default mt7981 if TARGET_mediatek_mt7981
	default mt7988 if TARGET_mediatek_mt7988
	default mt7987 if TARGET_mediatek_mt7987
	help
		Value will be set depending on TARGET, default not need set by user.

config WARP_VERSION
	string "WARP Driver HW Version"
	default 1 if TARGET_mediatek_mt7622
	default 1 if TARGET_airoha_en7563
	default 2 if TARGET_mediatek_mt7986
	default 2 if TARGET_mediatek_mt7981
	default 3 if TARGET_mediatek_mt7988
	default 3_1 if TARGET_mediatek_mt7987
	help
		Value will be set depending on TARGET, default not need set by user.

config WED_HW_RRO_SUPPORT
	bool "WARP Driver WED HW RRO (WO RRO) Support"
	depends on WARP_CONFIG_MODE = 0
	default y if TARGET_mediatek_mt7986 || TARGET_mediatek_mt7981 || TARGET_mediatek_mt7988
	default n
	help
		Value will be set depending on TARGET, default not need set by user.

config WARP_DBG_SUPPORT
	bool "WARP Driver Debug Info Support"
	default y

config MTK_MEMORY_SHRINK
	bool "WARP Driver Memory Shrink"
	default n

config WARP_MEMORY_LEAK_DBG
	bool "Memory leak debug"
	depends on WARP_CONFIG_MODE = 0
	depends on !MTK_MEMORY_SHRINK && WARP_DBG_SUPPORT
	default y

config WARP_WO_EMBEDDED_LOAD
	bool "WARP Driver Emebedded MCU FW"
	default n
	depends on WED_HW_RRO_SUPPORT
	help
		Once enabled, firmware download flow try embedded version once externel version being invalid.

endif
```

## target/linux/mediatek/files-6.6/drivers/net/phy/airoha/an8855/Kconfig
```kconfig
config AN8855_GSW
	tristate "Driver for the Airoha AN8855 switch"
	help
	  Airoha AN8855 devices and swconfig driver code,
	  Provide swconfig command for basic switch operation.
	  AN8855 support 2.5G speed and managed by SMI interface.
	  To compile this driver as a module, choose M here.
```

## target/linux/mediatek/image/Config.in
```kconfig
menuconfig MTK_SECURE_BOOT
	bool "Enable Secure Boot"
	select PACKAGE_dmsetup
	select PACKAGE_cryptsetup
	default n
	help
	  Select mtk secure boot

if MTK_SECURE_BOOT

config SBC_KEY_DIR
	string "secure boot key directory"
	default "../../keys"

config FIT_SIGN_KEY_NAME
	string "FIT sign key name"
	default "fit_key"

config FIT_SIGN_ALG
	string "FIT sign algorithm"
	default "sha256,rsa2048"

menuconfig MTK_FW_ENC
	bool "Enable firmware encryption"
	default n
	help
	  Select mtk firmware encryption

if MTK_FW_ENC

choice
	prompt "Choose rootfs encryption method"
	default MTK_FW_ENC_USE_RAMDISK

config MTK_FW_ENC_USE_RAMDISK
	bool "use RAM disk"
	select KERNEL_BLK_DEV_RAM
	help
	  decrypt the whold rootfs to RAM, and mounting as RAM disk

endchoice

choice
	prompt "Choose firmware decryption backend"
	default FW_ENC_DECRYPT_VIA_BL32

config FW_ENC_DECRYPT_VIA_BL31
	bool "Decrypt firmware via BL31"

config FW_ENC_DECRYPT_VIA_BL32
	bool "Decrypt firmware via BL32"
	select PACKAGE_optee-mediatek
	select OPTEE_FW_ENC_EARLY_TA

endchoice

config FW_ENC_ALG
	string
	default "tee_aes256" if FW_ENC_DECRYPT_VIA_BL31
	default "optee_aes256" if FW_ENC_DECRYPT_VIA_BL32

config PLAT_KEY_NAME
	string "platform key name"
	default "plat_key"

config ROE_SALT
	string "ROE key salt"
	default "salt/roe_salt.bin"

config KERNEL_SALT
	string "Kernel encryption key salt"
	default "salt/kernel_salt.bin"

config ROOTFS_SALT
	string "Rootfs encryption key salt"
	default "salt/rootfs_salt.bin"

endif # MTK_FW_ENC

menuconfig MTK_ANTI_ROLLBACK
	bool "Enable Anti-Rollback"
	default n
	help
	  Select mtk anti-rollback

if MTK_ANTI_ROLLBACK

config ANTI_ROLLBACK_TABLE
	string "Anti-Rollback table"
	default "../../fw_ar_table.xml"

config AUTO_AR_CONF
	string "Anti-Rollback auto config"
	default "auto_ar_conf.mk"

endif # MTK_ANTI_ROLLBACK

endif # MTK_SECURE_BOOT
```
