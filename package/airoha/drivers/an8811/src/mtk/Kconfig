## package/airoha/drivers/an8811/src/mtk/Kconfig
```kconfig
config AIROHA_EN8811H_PHY
	tristate "Airoha EN8811H PHY support"
	depends on PHYLIB
	help
	  Enable support for Airoha EN8811H 2.5G PHY driver.
```

## package/mtk/drivers/mt_hwifi/config.in
```kconfig
if PACKAGE_kmod-mt_hwifi

config MTK_HWIFI_PCI_SUPPORT
	bool "HWIFI PCIE/AXI Support"
	default y
	select PACKAGE_kmod-mtk_pci
	depends on PACKAGE_kmod-mt_hwifi

config MTK_HWIFI_CONNAC_IF_SUPPORT
	bool "HWIFI abstraction layer for CONNAC3/5 interface"
	default y
	select PACKAGE_kmod-connac_if
	depends on PACKAGE_kmod-mt_hwifi

config MTK_HWIFI_WED_SUPPORT
	bool "HWIFI WED Support"
	select PACKAGE_kmod-mtk_wed
	depends on PACKAGE_kmod-warp && PACKAGE_kmod-mtk_pci
	default n

config EN_HWIFI_NPU_SUPPORT
	bool "HWIFI NPU Support"
	select PACKAGE_kmod-en_npu
	depends on PACKAGE_kmod-warp && PACKAGE_kmod-mtk_pci && PACKAGE_kmod-mtk_wed
	default n

config MTK_HWIFI_MD_COEX_SUPPORT
	bool "HWIFI MD COEX Support"
	depends on MTK_HWIFI_WED_SUPPORT
	default n

config MTK_HWIFI_SW_AMSDU
	bool "HWIFI SW AMSDU Support"
	depends on PACKAGE_kmod-mt_hwifi
	default n

config MTK_HWIFI_RX_PROCESS_WORKQUEUE
	bool "HWIFI Rx Process WQ Support"
	depends on PACKAGE_kmod-mt_hwifi
	default n

config MTK_HWIFI_MEM_SHRINK
	bool "HWIFI Memory Shrink"
	depends on PACKAGE_kmod-mt_hwifi
	default n

menu "HWIFI Chips Support"
	config MTK_HWIFI_MT7915
		bool "mt7915"
		select PACKAGE_kmod-mt7915_
		depends on PACKAGE_kmod-mt_hwifi
	config MTK_HWIFI_MT7916
		bool "mt7916"
		select PACKAGE_kmod-mt7916_
		depends on PACKAGE_kmod-mt_hwifi

	config MTK_HWIFI_BELLWETHER
		bool "bellwether"
		select PACKAGE_kmod-bellwether
		depends on PACKAGE_kmod-mt_hwifi

	config MTK_HWIFI_MT7990
		bool "mt7990"
		select PACKAGE_kmod-mt7990
		depends on PACKAGE_kmod-mt_hwifi
	config MTK_HWIFI_MT7991
		bool "mt7991"
		select PACKAGE_kmod-mt7991
		depends on PACKAGE_kmod-mt_hwifi
	config MTK_HWIFI_MT7992
		bool "mt7992"
		select PACKAGE_kmod-mt7992
		depends on PACKAGE_kmod-mt_hwifi
	config MTK_HWIFI_MT799A
		bool "mt799a"
		select PACKAGE_kmod-mt799a
		depends on PACKAGE_kmod-mt_hwifi
	config MTK_HWIFI_MT7993
		bool "mt7993"
		select PACKAGE_kmod-mt7993
		depends on PACKAGE_kmod-mt_hwifi
	config MTK_HWIFI_MT799B
		bool "mt799b"
		select PACKAGE_kmod-mt799b
		depends on PACKAGE_kmod-mt7993
	config MTK_HWIFI_BLACKHAWK_A0
		bool "blackhawk_a0"
		select PACKAGE_kmod-blackhawk_a0
		depends on PACKAGE_kmod-mt_hwifi
	config MTK_HWIFI_BLACKHAWK_A0_PCIE1
		bool "blackhawk_a0_pcie1"
		select PACKAGE_kmod-blackhawk_a0_pcie1
		depends on PACKAGE_kmod-blackhawk_a0
endmenu

endif #PACKAGE_kmod-mt_hwifi#
```

## package/mtk/drivers/mt_hwifi/src/wlan_hwifi/scripts/hwifi.package/config.in
```kconfig
if PACKAGE_kmod-hwifi

config HWIFI
        bool "Enable HWIFI kernel module"
	default y

config HWIFI_HE_SUPPORT
	bool "HWIFI driver HE support"
	default n

config HWIFI_HIF_PCI
	bool "HWIFI PCIE driver support"
	default y

config HWIFI_IF_MTK
	bool "HWIFI MTK MAC interface support"
	default y

config HWIFI_IF_MAC80211
	bool "HWIFI MAC80211 interface support"
	default n

config HWIFI_CHIP_MT7915
	bool "HWIFI MT7915 chip support"
	default y

config HWIFI_CHIP_MT7916
	bool "HWIFI MT7916 chip support"
	default y

config HWIFI_CHIP_MT7915_IF_TYPE
	int "MT7915 default interface type"
	default 1

endif
```
