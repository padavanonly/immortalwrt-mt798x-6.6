// SPDX-License-Identifier: (GPL-2.0 OR MIT)

/dts-v1/;
#include "mt7986a-ruijie-rg-x60-new.dtsi"
#include "mt7986a-ruijie-ubi-ubootmod.dtsi"

/ {
	compatible = "ruijie,rg-x60-new-ubootmod", "mediatek,mt7986a";
	model = "Ruijie RG-X60 New (OpenWrt U-Boot layout)";
};
