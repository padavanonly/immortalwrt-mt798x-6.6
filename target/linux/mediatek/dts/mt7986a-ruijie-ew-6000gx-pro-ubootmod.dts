// SPDX-License-Identifier: (GPL-2.0 OR MIT)

/dts-v1/;
#include "mt7986a-ruijie-ew-6000gx-pro.dtsi"
#include "mt7986a-ruijie-ubi-ubootmod.dtsi"

/ {
	compatible = "ruijie,ew-6000gx-pro-ubootmod", "mediatek,mt7986a";
	model = "Ruijie EW-6000GX Pro (OpenWrt U-Boot layout)";
};
