// SPDX-License-Identifier: (GPL-2.0 OR MIT)

/dts-v1/;
#include "mt7986a-ruijie-rg-x60-new-common.dtsi"

/ {
	compatible = "ruijie,rg-x60-new-expand", "mediatek,mt7986a";
	model = "Ruijie RG-X60 New (expand layout)";
};

&partitions {
	partition@680000 {
		label = "ubi";
		reg = <0x680000 0x7100000>;
	};
};

&spi_nand {
	mediatek,nmbm;
	mediatek,bmt-max-ratio = <1>;
	mediatek,bmt-max-reserved-blocks = <64>;
};
