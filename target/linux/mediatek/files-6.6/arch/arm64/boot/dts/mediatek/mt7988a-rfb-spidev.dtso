// SPDX-License-Identifier: (GPL-2.0 OR MIT)
/*
 * Copyright (C) 2025 MediaTek Inc.
 * Author: Tim.Kuo <Tim.Kuo@mediatek.com>
 */

/dts-v1/;
/plugin/;

/ {
	compatible = "mediatek,mt7988a-rfb", "mediatek,mt7988a";

	fragment@1 {
		target = <&spi1>;
		__overlay__ {
			pinctrl-names = "default";
			pinctrl-0 = <&spi1_pins>;
			status = "okay";

			spi_dev1: spi@0 {
				compatible = "rohm,dh2228fv";
				reg = <0>;
				spi-max-frequency = <52000000>;
			};
		};
	};
};
